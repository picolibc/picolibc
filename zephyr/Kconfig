## zephyr/Kconfig
```kconfig
# Copyright © 2021 Amazon.com, Inc. or its affiliates.
# SPDX-License-Identifier: Apache-2.0

config PICOLIBC_MODULE
	bool "picolibc module support"
	help
	  This option builds the picolibc module. It is only used if
	  PICOLIBC_USE_MODULE is selected.
```
